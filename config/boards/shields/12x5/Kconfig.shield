## config/boards/shields/12x5/Kconfig.shield
```kconfig
# Copyright (c) 2020 The ZMK Contributors
# SPDX-License-Identifier: MIT
# https://zmkfirmware.dev/docs/development/new-shield#kconfigshield

config 12x5
    def_bool $(shields_list_contains,12x5)
```
